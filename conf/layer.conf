## conf/layer.conf
```bitbake
# We have a conf and classes directory, add to BBPATH
BBPATH .= ":${LAYERDIR}"

# We have recipes-* directories, add to BBFILES
BBFILES += "${LAYERDIR}/recipes-*/*/*.bb \
            ${LAYERDIR}/recipes-*/*/*.bbappend"

BBFILE_COLLECTIONS += "meta-qing"
BBFILE_PATTERN_meta-qing = "^${LAYERDIR}/"
BBFILE_PRIORITY_meta-qing = "6"

LAYERDEPENDS_meta-qing = "core"
LAYERSERIES_COMPAT_meta-qing = "scarthgap"
```
